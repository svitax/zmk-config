## config/west.yml
```yaml
manifest:
  defaults:
    remote: urob
    revision: v0.3 # Pin everything to v0.3
  remotes:
    - name: zmkfirmware
      url-base: https://github.com/zmkfirmware
    - name: urob
      url-base: https://github.com/urob
    - name: boardsource
      url-base: https://github.com/boardsource
    # Additional modules containing boards/shields/custom code can be listed here as well
    # See https://docs.zephyrproject.org/3.2.0/develop/west/manifest.html#projects
  projects:
    - name: zmk
      remote: zmkfirmware
      import: app/west.yml
    # ZMK modules
    - name: zmk-helpers
      path: modules/zmk/helpers
    - name: zmk-auto-layer
      path: modules/zmk/auto-layer
    - name: zmk-tri-state
      path: modules/zmk/tri-state
    # BLECorne
    - name: wireless-corne_zmk_config
      remote: boardsource
  self:
    path: config
```
