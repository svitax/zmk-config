/*
 * Copyright (c) 2020 The ZMK Contributors
 *
 * SPDX-License-Identifier: MIT
 */

#include <behaviors.dtsi>
#include <behaviors/num_word.dtsi> // Requires auto-layer module.
#include <dt-bindings/zmk/keys.h>
#include <dt-bindings/zmk/bt.h>
#include <dt-bindings/zmk/outputs.h>

#include "zmk-helpers/helper.h"

#define DEF 0
#define QWE 1
#define CUR 2
#define NUM 3
#define FN 4
#define WOR 5
#define SYS 6

#define XXX &none
#define ___ &trans

/* Global defaults */

#define QUICK_TAP_MS 175

&sk {
  release-after-ms = <900>;
  quick-release;
};

&sl { // Allow sticky mods to chord across sticky layers.
  ignore-modifiers;
};

&lt {
  flavor = "balanced";
  tapping-term-ms = <200>;
  quick-tap-ms = <QUICK_TAP_MS>;
};

/* Homerow mods */

#include "zmk-helpers/key-labels/42.h"
#define KEYS_L LT0 LT1 LT2 LT3 LT4 LT5 LM0 LM1 LM2 LM3 LM4 LM5 LB0 LB1 LB2 LB3 LB4 LB5
#define KEYS_R RT0 RT1 RT2 RT3 RT4 RT5 RM0 RM1 RM2 RM3 RM4 RM5 RB0 RB1 RB2 RB3 RB4 RB5
#define THUMBS LH2 LH1 LH0 RH0 RH1 RH2

#define MAKE_HRM(NAME, HOLD, TAP, TRIGGER_POS)                                 \
  ZMK_HOLD_TAP(NAME, bindings = <HOLD>, <TAP>; flavor = "balanced";            \
               tapping-term-ms = <280>; quick-tap-ms = <QUICK_TAP_MS>;         \
               require-prior-idle-ms = <150>; hold-trigger-on-release;         \
               hold-trigger-key-positions = <TRIGGER_POS>;)

MAKE_HRM(hml, &kp, &kp, KEYS_R THUMBS) // Left-hand HRMs.
MAKE_HRM(hmr, &kp, &kp, KEYS_L THUMBS) // Right-hand HRMs.

// Hack: Make HRM combos tap-only (cf, ZMK issue #544).
#define ZMK_COMBO_8(NAME, TAP, POS, LAYERS, COMBO_MS, IDLE_MS, HOLD, SIDE)     \
  MAKE_HRM(hm_combo_##NAME, &kp, TAP, SIDE THUMBS)                             \
  ZMK_COMBO(NAME, &hm_combo_##NAME HOLD 0, POS, LAYERS, COMBO_MS, IDLE_MS)

/* Combos */

#include "combos.dtsi" // Must be sourced after HRM-combo hack.

/* Smart-shift & auto-layers */

// TODO make tap yield sticky caps/nums and double tap yield caps/num word

// Tap: caps-word | double-tap: sticky caps-layer | Hold: shift.
#define SMART_SHFT &smart_shft LSHFT 0
ZMK_HOLD_TAP(smart_shft, bindings = <&kp>, <&shft_dance>; flavor = "balanced";
             tapping-term-ms = <200>; quick-tap-ms = <QUICK_TAP_MS>;)
ZMK_TAP_DANCE(shft_dance, bindings = <&sk LSHFT>, <&caps_word>;
              tapping-term-ms = <200>;)
&caps_word {
    /delete-property/ ignore-numbers;
    continue-list = <BACKSPACE ENTER DELETE UNDERSCORE MINUS>;
};

// Tap: num-word | double-tap: sticky num-layer | Hold: num-layer.
#define SMART_NUM &smart_num NUM 0
ZMK_HOLD_TAP(smart_num, bindings = <&mo>, <&num_dance>; flavor = "balanced";
             tapping-term-ms = <200>; quick-tap-ms = <QUICK_TAP_MS>;)
ZMK_TAP_DANCE(num_dance, bindings = <&sl NUM>, <&num_word NUM>;
             tapping-term-ms = <200>;)


// TODO smart_nav

/* Select word / line
 *
 * Approximation of Pascal Getreuer's Select Word macro from QMK
 * - https://getreuer.info/posts/keyboards/select-word/index.html
 */

//
// SELECT_WORD_DELAY defines how long the macro waits (miliseconds) after moving
// the cursor before it selects a word. A larger delay may allow the macro to
// move to the next word upon each invocation.
//
#ifndef SELECT_WORD_DELAY
#define SELECT_WORD_DELAY 1
#endif

#define select_all kp LC(A)

ZMK_MACRO(select_none,
wait-ms = <SELECT_WORD_DELAY>;
tap-ms = <SELECT_WORD_DELAY>;
bindings = <&kp DOWN &kp UP &kp RIGHT &kp LEFT>;
)

ZMK_TAP_DANCE(sel_all_none, bindings = <&select_all>, <&select_none>;
tapping-term-ms = <200>;)

//
// select a word (jumps to next word upon each successive invocation)
//
ZMK_MOD_MORPH(select_word,
    bindings = <&select_word_right>, <&select_word_left>;
    mods = <(MOD_LSFT|MOD_RSFT)>;)
ZMK_MACRO(select_word_right,
wait-ms = <SELECT_WORD_DELAY>;
tap-ms = <SELECT_WORD_DELAY>;
bindings = <&kp LC(RIGHT) &kp LC(LEFT) &kp LC(LS(RIGHT))>;
)
ZMK_MACRO(select_word_left,
wait-ms = <SELECT_WORD_DELAY>;
tap-ms = <SELECT_WORD_DELAY>;
bindings = <&kp LC(LEFT) &kp LC(RIGHT) &kp LC(LS(LEFT))>;
)

//
// extend current selection by one word
//
ZMK_MOD_MORPH(extend_word,
    bindings = <&extend_word_right>, <&extend_word_left>;
    mods = <(MOD_LSFT|MOD_RSFT)>;)
ZMK_MACRO(extend_word_right,
wait-ms = <SELECT_WORD_DELAY>;
tap-ms = <SELECT_WORD_DELAY>;
bindings = <&kp LC(LS(RIGHT))>;
)
ZMK_MACRO(extend_word_left,
wait-ms = <SELECT_WORD_DELAY>;
tap-ms = <SELECT_WORD_DELAY>;
bindings = <&kp LC(LS(LEFT))>;
)

ZMK_TAP_DANCE(sel_ext_word, bindings = <&select_word>, <&extend_word>;
tapping-term-ms = <200>;)

//
// select current line
//
ZMK_MOD_MORPH(select_line,
    bindings = <&select_line_right>, <&select_line_left>;
    mods = <(MOD_LSFT|MOD_RSFT)>;)
ZMK_MACRO(select_line_right,
wait-ms = <SELECT_WORD_DELAY>;
tap-ms = <SELECT_WORD_DELAY>;
bindings = <&kp HOME &kp LS(END)>;
)
ZMK_MACRO(select_line_left,
wait-ms = <SELECT_WORD_DELAY>;
tap-ms = <SELECT_WORD_DELAY>;
bindings = <&kp END &kp LS(HOME)>;
)

//
// extend current selection by one line
//
ZMK_MOD_MORPH(extend_line,
    bindings = <&extend_line_right>, <&extend_line_left>;
    mods = <(MOD_LSFT|MOD_RSFT)>;)
ZMK_MACRO(extend_line_right,
wait-ms = <SELECT_WORD_DELAY>;
tap-ms = <SELECT_WORD_DELAY>;
bindings = <&kp LS(DOWN) &kp LS(END)>;
)
ZMK_MACRO(extend_line_left,
wait-ms = <SELECT_WORD_DELAY>;
tap-ms = <SELECT_WORD_DELAY>;
bindings = <&kp LS(UP) &kp LS(HOME)>;
)

ZMK_TAP_DANCE(sel_ext_line, bindings = <&select_line>, <&extend_line>;
tapping-term-ms = <200>;)

/* Mod-morphs */

// Define a mod-morph with a *single* mod trigger for less repetition.
#define SIMPLE_MORPH(NAME, MOD, BINDING1, BINDING2)                            \
  ZMK_MOD_MORPH(NAME, mods = <(MOD_L##MOD | MOD_R##MOD)>;                      \
                bindings = <BINDING1>, <BINDING2>;)

// Tap: qmark | Shift + tap: excl.
SIMPLE_MORPH(qexcl, SFT, &kp QMARK, &kp EXCL)

/* Misc aliases */

#define PREV      &hmr LSHFT C_PREV       // Previous.
#define NEXT      &hmr LALT C_NEXT        // Next.
#define VOL_DOWN  &hmr RCTRL C_VOL_DN
#define VOL_UP    &kp C_VOL_UP
#define SPACE_CUR &lt CUR SPACE
#define RET_FN    &lt FN RET
#define SC        SEMICOLON

/* Keymap */

// TODO possibly switch to canary layout

ZMK_CONDITIONAL_LAYER(fn, CUR NUM, SYS) // CUR + NUM --> SYS.

#ifndef ZMK_BASE_LAYER
  #define ZMK_BASE_LAYER(name, LT, RT, LM, RM, LB, RB, LH, RH)                 \
      ZMK_LAYER(name, LT RT LM RM LB RB LH RH)
#endif

// Enthium Layout
//  qyou=   xldpz
// bciae-   khtnsw
//  ',.;/   jmgfv
//     S     r

// smart_shift on a home-thumb (shifting alphas conflicts with home-row mods)
// smart_num on a left thumb
// combos instead of a symbol layer (i don't like horizontal combos)

// esc
// tab
// bkspace / del
// enter / ins

// cursor/nav layer (arrow keys, nav keys, select and extend on thumbs?)
// func layer (ideally on left with smart_num. media + func keys on right, system keys on left)
// world layer (ideally on right because all vowels are on left)

// layer locking? (hold and then tap key for layer you want to lock? or double tap a layer to lock it?)
// mouse layer? (wasd nav)

// system layer (brightness, power control, screen lock, print screen, etc.)

ZMK_BASE_LAYER(Base,
//╭─────────────┬─────────────┬─────────────┬─────────────┬─────────────┬─────────────╮ ╭─────────────┬─────────────┬─────────────┬─────────────┬─────────────┬─────────────╮
    &to QWE       &kp Q         &kp Y         &kp O         &kp U         &kp EQUAL   ,   &kp X         &kp L         &kp D         &kp P         &kp Z         ___         ,
//├─────────────┬─────────────┼─────────────┼─────────────┼─────────────┼─────────────┤ ├─────────────┬─────────────┼─────────────┼─────────────┼─────────────┼─────────────┤
    &kp B         &hml LSHFT C  &hml LGUI I   &hml LCTRL A  &hml LALT E   &kp MINUS   ,   &kp K         &hmr LALT H   &hmr RCTRL T  &hmr RGUI N   &hmr RSHFT S  &kp W       ,
//├─────────────┬─────────────┼─────────────┼─────────────┼─────────────┼─────────────┤ ├─────────────┬─────────────┼─────────────┼─────────────┼─────────────┼─────────────┤
    ___           &kp SQT       &kp COMMA     &kp DOT       &kp SEMICOLON &kp FSLH    ,   &kp J         &kp M         &kp G         &kp F         &kp V         ___         ,
//╰─────────────┬─────────────┼─────────────┴─────────────┼─────────────┼─────────────┤ ├─────────────┬─────────────┼─────────────┼─────────────┴───────────────────────────╯
                                              SMART_NUM     RET_FN        SPACE_CUR   ,   SMART_SHFT    &kp R         &sl WOR
//                                          ╰─────────────┴─────────────┴─────────────╯ ╰─────────────┴─────────────┴─────────────╯
)

ZMK_BASE_LAYER(Qwerty,
//╭─────────────┬─────────────┬─────────────┬─────────────┬─────────────┬─────────────╮ ╭─────────────┬─────────────┬─────────────┬─────────────┬─────────────┬─────────────╮
    &to DEF       &kp Q         &kp W         &kp E         &kp R         &kp T       ,   &kp Y         &kp U         &kp I         &kp O         &kp P         ___         ,
//├─────────────┬─────────────┼─────────────┼─────────────┼─────────────┼─────────────┤ ├─────────────┬─────────────┼─────────────┼─────────────┼─────────────┼─────────────┤
    ___           &hml LSHFT A  &hml LGUI S   &hml LCTRL D  &hml LALT F   &kp G       ,   &kp H         &hmr LALT J   &hmr RCTRL K  &hmr RGUI L   &hmr RSHFT SC &kp SQT     ,
//├─────────────┬─────────────┼─────────────┼─────────────┼─────────────┼─────────────┤ ├─────────────┬─────────────┼─────────────┼─────────────┼─────────────┼─────────────┤
    ___           &kp Z         &kp X         &kp C         &kp V         &kp B       ,   &kp N         &kp M         &kp COMMA     &kp DOT       &kp FSLH      ___         ,
//╰─────────────┬─────────────┼─────────────┴─────────────┼─────────────┼─────────────┤ ├─────────────┬─────────────┼─────────────┼─────────────┴───────────────────────────╯
                                              SMART_NUM     RET_FN        SPACE_CUR   ,   SMART_SHFT    ___           &sl WOR
//                                          ╰─────────────┴─────────────┴─────────────╯ ╰─────────────┴─────────────┴─────────────╯
)

ZMK_BASE_LAYER(Cursor,
//╭─────────────┬─────────────┬─────────────┬─────────────┬─────────────┬─────────────╮ ╭─────────────┬─────────────┬─────────────┬─────────────┬─────────────┬─────────────╮
    ___           &kp ESC       &kp INS       &kp LS(TAB)   &kp DEL       ___         ,   &kp LS(TAB)   &kp K_UNDO    &kp K_REDO    &kp TAB       ___           ___         ,
//├─────────────┬─────────────┼─────────────┼─────────────┼─────────────┼─────────────┤ ├─────────────┬─────────────┼─────────────┼─────────────┼─────────────┼─────────────┤
    ___           &sk LSHFT     &sk LGUI      &sk LCTRL     &sk LALT      ___         ,   &kp LEFT      &kp DOWN      &kp UP        &kp RIGHT     ___           ___         ,
//├─────────────┬─────────────┼─────────────┼─────────────┼─────────────┼─────────────┤ ├─────────────┬─────────────┼─────────────┼─────────────┼─────────────┼─────────────┤
    ___           &kp RET       &kp SPACE     &kp TAB       &kp BSPC      ___         ,   &kp HOME      &kp PG_DN     &kp PG_UP     &kp END       ___           ___         ,
//╰─────────────┬─────────────┼─────────────┴─────────────┼─────────────┼─────────────┤ ├─────────────┬─────────────┼─────────────┼─────────────┴───────────────────────────╯
                                              ___           ___           ___         ,   &sel_ext_word &sel_ext_line &sel_all_none
//                                          ╰─────────────┴─────────────┴─────────────╯ ╰─────────────┴─────────────┴─────────────╯
)

ZMK_BASE_LAYER(Num,
//╭─────────────┬─────────────┬─────────────┬─────────────┬─────────────┬─────────────╮ ╭─────────────┬─────────────┬─────────────┬─────────────┬─────────────┬─────────────╮
    ___           &kp ESC       &kp INS       &kp LS(TAB)   &kp DEL       &kp TILDE   ,   &kp CARET     &kp N7        &kp N8        &kp N9        &kp COLON     &kp PRCNT   ,
//├─────────────┬─────────────┼─────────────┼─────────────┼─────────────┼─────────────┤ ├─────────────┬─────────────┼─────────────┼─────────────┼─────────────┼─────────────┤
    ___           &sk LSHFT     &sk LGUI      &sk LCTRL     &sk LALT      &kp EXCL    ,   &kp HASH      &kp N4        &kp N5        &kp N6        &kp MINUS     &kp PLUS    ,
//├─────────────┬─────────────┼─────────────┼─────────────┼─────────────┼─────────────┤ ├─────────────┬─────────────┼─────────────┼─────────────┼─────────────┼─────────────┤
    ___           &kp RET       &kp SPACE     &kp TAB       &kp BSPC      &kp EQUAL   ,   &kp DOLLAR    &kp N1        &kp N2        &kp N3        &kp FSLH      &kp ASTRK   ,
//╰─────────────┬─────────────┼─────────────┴─────────────┼─────────────┼─────────────┤ ├─────────────┬─────────────┼─────────────┼─────────────┴───────────────────────────╯
                                              ___           ___           ___         ,   &kp COMMA     &kp N0        &kp DOT
//                                          ╰─────────────┴─────────────┴─────────────╯ ╰─────────────┴─────────────┴─────────────╯
)

ZMK_BASE_LAYER(Fn,
//╭─────────────┬─────────────┬─────────────┬─────────────┬─────────────┬─────────────╮ ╭─────────────┬─────────────┬─────────────┬─────────────┬─────────────┬─────────────╮
    &bt BT_CLR    &bt BT_SEL 0  &kp C_BRI_UP  &kp C_VOL_UP  &kp C_PREV    &bootloader ,   &bootloader   &kp F7        &kp F8        &kp F9        &kp F10       &kp F13     ,
//├─────────────┬─────────────┼─────────────┼─────────────┼─────────────┼─────────────┤ ├─────────────┬─────────────┼─────────────┼─────────────┼─────────────┼─────────────┤
    ___           &bt BT_SEL 1  &kp C_BRI_DN  &kp C_VOL_DN  &kp C_NEXT    &sys_reset  ,   &sys_reset    &kp F4        &kp F5        &kp F6        &kp F11       &kp F14     ,
//├─────────────┬─────────────┼─────────────┼─────────────┼─────────────┼─────────────┤ ├─────────────┬─────────────┼─────────────┼─────────────┼─────────────┼─────────────┤
    ___           &bt BT_SEL 2  &kp PSCRN     &kp C_MUTE    &kp C_PP      &out OUT_TOG,   &out OUT_TOG  &kp F1        &kp F2        &kp F3        &kp F12       &kp F15     ,
//╰─────────────┬─────────────┼─────────────┴─────────────┼─────────────┼─────────────┤ ├─────────────┬─────────────┼─────────────┼─────────────┴───────────────────────────╯
                                              ___           ___           ___         ,   &kp C_PWR     &kp K_LOCK    &kp C_SLEEP
//                                          ╰─────────────┴─────────────┴─────────────╯ ╰─────────────┴─────────────┴─────────────╯
)

ZMK_BASE_LAYER(World,
//╭─────────────┬─────────────┬─────────────┬─────────────┬─────────────┬─────────────╮ ╭─────────────┬─────────────┬─────────────┬─────────────┬─────────────┬─────────────╮
    ___           &kp Q         &kp Y         &kp O         &kp U         &kp EQUAL   ,   &kp X         &kp L         &kp D         &kp P         &kp Z         ___         ,
//├─────────────┬─────────────┼─────────────┼─────────────┼─────────────┼─────────────┤ ├─────────────┬─────────────┼─────────────┼─────────────┼─────────────┼─────────────┤
    &kp B         &hml LSHFT C  &hml LGUI I   &hml LCTRL A  &hml LALT E   &kp MINUS   ,   &kp K         &hmr LALT H   &hmr RCTRL T  &hmr RGUI N   &hmr RSHFT S  &kp W       ,
//├─────────────┬─────────────┼─────────────┼─────────────┼─────────────┼─────────────┤ ├─────────────┬─────────────┼─────────────┼─────────────┼─────────────┼─────────────┤
    &sl FN        &kp SQT       &kp COMMA     &kp DOT       &kp SEMICOLON &kp FSLH    ,   &kp J         &kp M         &kp G         &kp F         &kp V         ___         ,
//╰─────────────┬─────────────┼─────────────┴─────────────┼─────────────┼─────────────┤ ├─────────────┬─────────────┼─────────────┼─────────────┴───────────────────────────╯
                                              SMART_NUM     SPACE_CUR     &kp RET     ,   SMART_SHFT    &kp R         &sl WOR
//                                          ╰─────────────┴─────────────┴─────────────╯ ╰─────────────┴─────────────┴─────────────╯
)

ZMK_BASE_LAYER(Sys,
//╭─────────────┬─────────────┬─────────────┬─────────────┬─────────────┬─────────────╮ ╭─────────────┬─────────────┬─────────────┬─────────────┬─────────────┬─────────────╮
    ___           ___           ___           &bt BT_CLR    ___           &out OUT_TOG,   ___           &kp C_BRI_DN  &kp C_BRI_UP  ___           ___           ___         ,
//├─────────────┬─────────────┼─────────────┼─────────────┼─────────────┼─────────────┤ ├─────────────┬─────────────┼─────────────┼─────────────┼─────────────┼─────────────┤
    ___           ___           &bt BT_PRV    ___           &bt BT_NXT    &bootloader ,   PREV          VOL_DOWN      VOL_UP        NEXT          ___           ___         ,
//├─────────────┬─────────────┼─────────────┼─────────────┼─────────────┼─────────────┤ ├─────────────┬─────────────┼─────────────┼─────────────┼─────────────┼─────────────┤
    ___           ___           ___           ___           ___           &sys_reset  ,   &kp C_RW      &kp C_MUTE    &kp C_PP      &kp C_FF      ___           ___         ,
//╰─────────────┬─────────────┼─────────────┴─────────────┼─────────────┼─────────────┤ ├─────────────┬─────────────┼─────────────┼─────────────┴───────────────────────────╯
                                              ___           ___           ___         ,   ___           ___           ___
//                                          ╰─────────────┴─────────────┴─────────────╯ ╰─────────────┴─────────────┴─────────────╯
)
