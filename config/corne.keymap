/*
 * Copyright (c) 2020 The ZMK Contributors
 *
 * SPDX-License-Identifier: MIT
 */

#include <behaviors.dtsi>
#include <behaviors/num_word.dtsi> // Requires auto-layer module.
#include <dt-bindings/zmk/keys.h>
#include <dt-bindings/zmk/bt.h>
#include <dt-bindings/zmk/outputs.h>

#include "zmk-helpers/helper.h"

#define DEF 0
#define QWE 1
#define NAV 2
#define FN 3
#define NUM 4
#define SYS 5
#define MOUSE 6

#define XXX &none
#define ___ &trans

/* Global defaults */

#define QUICK_TAP_MS 175

&sk {
  release-after-ms = <900>;
  quick-release;
};

&sl { // Allow sticky mods to chord across sticky layers.
  ignore-modifiers;
};

&lt {
  flavor = "balanced";
  tapping-term-ms = <200>;
  quick-tap-ms = <QUICK_TAP_MS>;
};

/* Homerow mods */

#include "zmk-helpers/key-labels/42.h"
#define KEYS_L LT0 LT1 LT2 LT3 LT4 LT5 LM0 LM1 LM2 LM3 LM4 LM5 LB0 LB1 LB2 LB3 LB4 LB5
#define KEYS_R RT0 RT1 RT2 RT3 RT4 RT5 RM0 RM1 RM2 RM3 RM4 RM5 RB0 RB1 RB2 RB3 RB4 RB5
#define THUMBS LH2 LH1 LH0 RH0 RH1 RH2

#define MAKE_HRM(NAME, HOLD, TAP, TRIGGER_POS)                                 \
  ZMK_HOLD_TAP(NAME, bindings = <HOLD>, <TAP>; flavor = "balanced";            \
               tapping-term-ms = <280>; quick-tap-ms = <QUICK_TAP_MS>;         \
               require-prior-idle-ms = <150>; hold-trigger-on-release;         \
               hold-trigger-key-positions = <TRIGGER_POS>;)

MAKE_HRM(hml, &kp, &kp, KEYS_R THUMBS) // Left-hand HRMs.
MAKE_HRM(hmr, &kp, &kp, KEYS_L THUMBS) // Right-hand HRMs.

// Hack: Make HRM combos tap-only (cf, ZMK issue #544).
#define ZMK_COMBO_8(NAME, TAP, POS, LAYERS, COMBO_MS, IDLE_MS, HOLD, SIDE)     \
  MAKE_HRM(hm_combo_##NAME, &kp, TAP, SIDE THUMBS)                             \
  ZMK_COMBO(NAME, &hm_combo_##NAME HOLD 0, POS, LAYERS, COMBO_MS, IDLE_MS)

/* Combos and mouse emulation */

#include "combos.dtsi" // Must be sourced after HRM-combo hack.
#include "mouse.dtsi"

/* Nav cluster */

#define NAV_LEFT  &kp LEFT
#define NAV_RIGHT &kp RIGHT
#define NAV_UP    &kp UP
#define NAV_DOWN  &kp DOWN

/* smart-shift & auto-layers */

// TODO make tap yield sticky caps/nums and double tap yield caps/num word

// Tap: caps-word | double-tap: sticky caps-layer | Hold: shift.
#define SMART_SHFT &smart_shft LSHFT 0
ZMK_HOLD_TAP(smart_shft, bindings = <&kp>, <&shft_dance>; flavor = "balanced";
             tapping-term-ms = <200>; quick-tap-ms = <QUICK_TAP_MS>;)
ZMK_TAP_DANCE(shft_dance, bindings = <&sk LSHFT>, <&caps_word>;
              tapping-term-ms = <200>;)
&caps_word {
    /delete-property/ ignore-numbers;
    continue-list = <BACKSPACE ENTER DELETE UNDERSCORE MINUS>;
};

// Tap: num-word | double-tap: sticky num-layer | Hold: num-layer.
#define SMART_NUM &smart_num NUM 0
ZMK_HOLD_TAP(smart_num, bindings = <&mo>, <&num_dance>; flavor = "balanced";
             tapping-term-ms = <200>; quick-tap-ms = <QUICK_TAP_MS>;)
ZMK_TAP_DANCE(num_dance, bindings = <&sl NUM>, <&num_word NUM>;
             tapping-term-ms = <200>;)

// Smart-mouse, requires tri-state module.
#define SMART_MOUSE &smart_mouse
ZMK_TRI_STATE(
    smart_mouse, bindings = <&tog MOUSE>, <&none>, <&tog MOUSE>;
    ignored-key-positions =
        <LT1 LT2 LH0 LH1 LH2 RT0 RT1 RT2 RT3 RM0 RM1 RM2 RM3 RB1 RB3 RH0 RH1 RH2>;
    ignored-layers = <MOUSE NAV FN>;)

// TODO smart_nav

/* Custom behaviors */

// Define mod-morph with a *single* mod trigger for less repetition.
#define SIMPLE_MORPH(NAME, MOD, BINDING1, BINDING2)                            \
  ZMK_MOD_MORPH(NAME, mods = <(MOD_L##MOD | MOD_R##MOD)>;                      \
                bindings = <BINDING1>, <BINDING2>;)

// Tap: comma | Shift + tap: semicolon.
SIMPLE_MORPH(comma_morph, SFT, &kp COMMA, &kp SEMICOLON)
// Tap: comma | Shift + tap: semicolon | Ctrl + shift + tap: <.
// SIMPLE_MORPH(comma_morph, SFT, &kp COMMA, &comma_inner_morph)
// SIMPLE_MORPH(comma_inner_morph, CTL, &kp SEMICOLON, &kp LESS_THAN)

// Tap: dot | Shift + tap: colon.
SIMPLE_MORPH(dot_morph, SFT, &kp DOT, &kp COLON)
// Tap: dot | Shift + tap: colon | Ctrl + shift + tap: >.
// SIMPLE_MORPH(dot_morph, SFT, &kp DOT, &dot_inner_morph)
// SIMPLE_MORPH(dot_inner_morph, CTL, &kp COLON, &kp GREATER_THAN)

// Tap: qmark | Shift + tap: excl.
SIMPLE_MORPH(qexcl, SFT, &kp QMARK, &kp EXCL)

// Tap: lbrc | Shift + tap: lpar
SIMPLE_MORPH(lbrc_lbkt, SFT, &kp LBRC, &kp LBKT)
// Tap: rbrc | Shift + tap: rpar
SIMPLE_MORPH(rbrc_rbkt, SFT, &kp RBRC, &kp RBKT)
// Tap: lpar | Shift + tap: lt
SIMPLE_MORPH(lpar_lt, SFT, &kp LPAR, &kp LT)
// Tap: rpar | Shift + tap: gt
SIMPLE_MORPH(rpar_gt, SFT, &kp RPAR, &kp GT)

// Misc aliases. [TODO: clean up]
#define CANCEL    &kp K_CANCEL            // Cancel caps-word & auto-layers.
#define PREV      &hmr LSHFT C_PREV       // Previous.
#define NEXT      &hmr LALT C_NEXT        // Next.
#define VOL_DOWN  &hmr RCTRL C_VOL_DN
#define VOL_UP    &kp C_VOL_UP
#define SPACE_NAV &lt NAV SPACE

/* Keymap */

// TODO possibly switch to canary layout

ZMK_CONDITIONAL_LAYER(fn, MOUSE FN, SYS) // MOUSE + FN --> SYS.
ZMK_CONDITIONAL_LAYER(fn, NAV NUM, SYS) // NAV + NUM --> SYS.

#ifndef ZMK_BASE_LAYER
  #define ZMK_BASE_LAYER(name, LT, RT, LM, RM, LB, RB, LH, RH)                 \
      ZMK_LAYER(name, LT RT LM RM LB RB LH RH)
#endif

ZMK_BASE_LAYER(Base,
//╭─────────────┬─────────────┬─────────────┬─────────────┬─────────────┬─────────────╮ ╭─────────────┬─────────────┬─────────────┬─────────────┬─────────────┬─────────────╮
    &kp ESC       &kp B         &kp L         &kp D         &kp W         &kp Z       ,   &kp SQT       &kp F         &kp O         &kp U         &kp J         &kp BSPC    ,
//├─────────────┬─────────────┼─────────────┼─────────────┼─────────────┼─────────────┤ ├─────────────┬─────────────┼─────────────┼─────────────┼─────────────┼─────────────┤
    &kp TAB       &hml LSHFT N  &hml LGUI R   &hml LCTRL T  &hml LALT S   &kp G       ,   &kp Y         &hmr RALT H   &hmr RCTRL A  &hmr RGUI E   &hmr RSHFT I  &kp RET     ,
//├─────────────┬─────────────┼─────────────┼─────────────┼─────────────┼─────────────┤ ├─────────────┬─────────────┼─────────────┼─────────────┼─────────────┼─────────────┤
    &tog QWE      &kp Q         &kp X         &kp M         &kp C         &kp V       ,   &kp K         &kp P         &comma_morph  &dot_morph    &qexcl        &sl FN      ,
//╰─────────────┬─────────────┼─────────────┴─────────────┼─────────────┼─────────────┤ ├─────────────┬─────────────┼─────────────┼─────────────┴───────────────────────────╯
                                              &sk LGUI      SPACE_NAV     &sk LALT    ,   &sk RCTRL     SMART_SHFT    SMART_NUM
//                                          ╰─────────────┴─────────────┴─────────────╯ ╰─────────────┴─────────────┴─────────────╯
)

ZMK_BASE_LAYER(Qwerty,
//╭─────────────┬─────────────┬─────────────┬─────────────┬─────────────┬─────────────╮ ╭─────────────┬─────────────┬─────────────┬─────────────┬─────────────┬─────────────╮
    ___           &kp Q         &kp W         &kp E         &kp R         &kp T       ,   &kp Y         &kp U         &kp I         &kp O         &kp P         ___         ,
//├─────────────┬─────────────┼─────────────┼─────────────┼─────────────┼─────────────┤ ├─────────────┬─────────────┼─────────────┼─────────────┼─────────────┼─────────────┤
    ___           &hml LSHFT A  &hml LGUI S   &hml LCTRL D  &hml LALT F   &kp G       ,   &kp H         &hmr RALT J   &hmr RCTRL K  &hmr RGUI L   &hmr RSHFT SQT ___        ,
//├─────────────┬─────────────┼─────────────┼─────────────┼─────────────┼─────────────┤ ├─────────────┬─────────────┼─────────────┼─────────────┼─────────────┼─────────────┤
    &tog QWE      &kp Z         &kp X         &kp C         &kp V         &kp B       ,   &kp N         &kp M         &comma_morph  &dot_morph    &qexcl        ___         ,
//╰─────────────┬─────────────┼─────────────┴─────────────┼─────────────┼─────────────┤ ├─────────────┬─────────────┼─────────────┼─────────────┴───────────────────────────╯
                                              &sk LGUI      SPACE_NAV     &sk LALT    ,   &sk RCTRL     SMART_SHFT    SMART_NUM
//                                          ╰─────────────┴─────────────┴─────────────╯ ╰─────────────┴─────────────┴─────────────╯
)

ZMK_BASE_LAYER(Nav,
//╭─────────────┬─────────────┬─────────────┬─────────────┬─────────────┬─────────────╮ ╭─────────────┬─────────────┬─────────────┬─────────────┬─────────────┬─────────────╮
    CANCEL        ___           ___           ___           ___           ___         ,   &lpar_lt      &lbrc_lbkt    &rbrc_rbkt    &rpar_gt      ___           ___         ,
//├─────────────┬─────────────┼─────────────┼─────────────┼─────────────┼─────────────┤ ├─────────────┬─────────────┼─────────────┼─────────────┼─────────────┼─────────────┤
    ___           &sk LGUI      &sk LALT      &sk LCTRL     &sk LSHFT     ___         ,   &kp LEFT      &kp DOWN      &kp UP        &kp RIGHT     ___           ___         ,
//├─────────────┬─────────────┼─────────────┼─────────────┼─────────────┼─────────────┤ ├─────────────┬─────────────┼─────────────┼─────────────┼─────────────┼─────────────┤
    ___           ___           ___           ___           ___           ___         ,   &kp HOME      &kp PG_DN     &kp PG_UP     &kp END       ___           ___         ,
//╰─────────────┬─────────────┼─────────────┴─────────────┼─────────────┼─────────────┤ ├─────────────┬─────────────┼─────────────┼─────────────┴───────────────────────────╯
                                              ___           ___           ___         ,   ___           ___           ___
//                                          ╰─────────────┴─────────────┴─────────────╯ ╰─────────────┴─────────────┴─────────────╯
)

ZMK_BASE_LAYER(Fn,
//╭─────────────┬─────────────┬─────────────┬─────────────┬─────────────┬─────────────╮ ╭─────────────┬─────────────┬─────────────┬─────────────┬─────────────┬─────────────╮
    ___           &kp F12       &kp F7        &kp F8        &kp F9        ___         ,   ___           ___           ___           ___           ___           ___         ,
//├─────────────┬─────────────┼─────────────┼─────────────┼─────────────┼─────────────┤ ├─────────────┬─────────────┼─────────────┼─────────────┼─────────────┼─────────────┤
    ___           &hml LGUI F11 &hml LALT F4  &hml LCTRL F5 &hml LSHFT F6 ___         ,   ___           ___           ___           ___           ___           ___         ,
//├─────────────┬─────────────┼─────────────┼─────────────┼─────────────┼─────────────┤ ├─────────────┬─────────────┼─────────────┼─────────────┼─────────────┼─────────────┤
    ___           &kp F10       &kp F1        &kp F2        &kp F3        ___         ,   ___           ___           ___           ___           ___           ___         ,
//╰─────────────┬─────────────┼─────────────┴─────────────┼─────────────┼─────────────┤ ├─────────────┬─────────────┼─────────────┼─────────────┴───────────────────────────╯
                                              ___           ___           ___         ,   ___           ___           ___
//                                          ╰─────────────┴─────────────┴─────────────╯ ╰─────────────┴─────────────┴─────────────╯
)

ZMK_BASE_LAYER(Num,
//╭─────────────┬─────────────┬─────────────┬─────────────┬─────────────┬─────────────╮ ╭─────────────┬─────────────┬─────────────┬─────────────┬─────────────┬─────────────╮
    ___           ___           &kp N7        &kp N8        &kp N9        ___         ,   ___           ___           ___           ___           ___           ___         ,
//├─────────────┬─────────────┼─────────────┼─────────────┼─────────────┼─────────────┤ ├─────────────┬─────────────┼─────────────┼─────────────┼─────────────┼─────────────┤
    ___           &sk LGUI      &hml LALT N4  &hml LCTRL N5 &hml LSHFT N6 ___         ,   ___           ___           ___           ___           ___           ___         ,
//├─────────────┬─────────────┼─────────────┼─────────────┼─────────────┼─────────────┤ ├─────────────┬─────────────┼─────────────┼─────────────┼─────────────┼─────────────┤
    ___           &kp N0        &kp N1        &kp N2        &kp N3        ___         ,   ___           ___           ___           ___           ___           ___         ,
//╰─────────────┬─────────────┼─────────────┴─────────────┼─────────────┼─────────────┤ ├─────────────┬─────────────┼─────────────┼─────────────┴───────────────────────────╯
                                              ___           ___           ___         ,   ___           ___           ___
//                                          ╰─────────────┴─────────────┴─────────────╯ ╰─────────────┴─────────────┴─────────────╯
)

ZMK_BASE_LAYER(Sys,
//╭─────────────┬─────────────┬─────────────┬─────────────┬─────────────┬─────────────╮ ╭─────────────┬─────────────┬─────────────┬─────────────┬─────────────┬─────────────╮
    ___           ___           ___           &bt BT_CLR    ___           &out OUT_TOG,   ___           &kp C_BRI_DN  &kp C_BRI_UP  ___           ___           ___         ,
//├─────────────┬─────────────┼─────────────┼─────────────┼─────────────┼─────────────┤ ├─────────────┬─────────────┼─────────────┼─────────────┼─────────────┼─────────────┤
    ___           ___           &bt BT_PRV    ___           &bt BT_NXT    &bootloader ,   PREV          VOL_DOWN      VOL_UP        NEXT          ___           ___         ,
//├─────────────┬─────────────┼─────────────┼─────────────┼─────────────┼─────────────┤ ├─────────────┬─────────────┼─────────────┼─────────────┼─────────────┼─────────────┤
    ___           ___           ___           ___           ___           &sys_reset  ,   &kp C_RW      &kp C_MUTE    &kp C_PP      &kp C_FF      ___           ___         ,
//╰─────────────┬─────────────┼─────────────┴─────────────┼─────────────┼─────────────┤ ├─────────────┬─────────────┼─────────────┼─────────────┴───────────────────────────╯
                                              ___           ___           ___         ,   ___           ___           ___
//                                          ╰─────────────┴─────────────┴─────────────╯ ╰─────────────┴─────────────┴─────────────╯
)

ZMK_BASE_LAYER(Mouse,
//╭─────────────┬─────────────┬─────────────┬─────────────┬─────────────┬─────────────╮ ╭─────────────┬─────────────┬─────────────┬─────────────┬─────────────┬─────────────╮
    ___           ___           ___           ___            ___           ___        ,   ___           &kp PG_DN     &kp PG_UP     ___           ___           ___         ,
//├─────────────┬─────────────┼─────────────┼─────────────┼─────────────┼─────────────┤ ├─────────────┬─────────────┼─────────────┼─────────────┼─────────────┼─────────────┤
    ___           ___           ___           ___           ___           ___         ,   U_MS_L        U_MS_D        U_MS_U        U_MS_R        ___           ___         ,
//├─────────────┬─────────────┼─────────────┼─────────────┼─────────────┼─────────────┤ ├─────────────┬─────────────┼─────────────┼─────────────┼─────────────┼─────────────┤
    ___           ___           ___           ___           ___           ___         ,   U_WH_L        U_WH_D        U_WH_U        U_WH_R        ___           ___         ,
//╰─────────────┬─────────────┼─────────────┴─────────────┼─────────────┼─────────────┤ ├─────────────┬─────────────┼─────────────┼─────────────┴───────────────────────────╯
                                              ___           CANCEL        ___         ,   &mkp LCLK     &mkp MCLK      &mkp RCLK
//                                          ╰─────────────┴─────────────┴─────────────╯ ╰─────────────┴─────────────┴─────────────╯
)
